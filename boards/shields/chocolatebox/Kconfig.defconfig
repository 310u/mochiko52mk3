## boards/shields/chocolatebox/Kconfig.defconfig
```kconfig
if CHOCOLATEBOX


config ZMK_KEYBOARD_NAME
    default "chocolatebox"

config ZMK_KSCAN
    bool
    default y

config ZMK_KSCAN_GPIO_MATRIX
    bool
    default y


endif # CHOCOLATEBOX
```

## boards/shields/chocolatebox/Kconfig.shield
```kconfig
# SPDX-License-Identifier: MIT

config SHIELD_CHOCOLATEBOX
    def_bool $(shields_list_contains,chocolatebox)
```

## config/boards/shields/chocolatebox/Kconfig.defconfig
```kconfig
if CHOCOLATEBOX

config ZMK_KEYBOARD_NAME
    default "chocolatebox"

config ZMK_MOUSE
    bool
    default y

config ZMK_MOUSE_PMW3610
    bool
    default y

config ZMK_DISPLAY
    bool
    default y

config ZMK_KSCAN
    bool
    default y

config ZMK_KSCAN_GPIO_MATRIX
    bool
    default y

# MCP23017のサポートを追加
config GPIO_MCP23017
    bool "Enable MCP23017 GPIO Expander"
    default y
    depends on I2C
    help
        Enable support for the MCP23017 I2C GPIO expander.

# バッテリー駆動のための省電力設定
config ZMK_IDLE_TIMEOUT
    int
    default 30000  # 30秒でスリープ

config ZMK_IDLE_POWERDOWN
    bool
    default y

# ディスプレイのスリープ設定（省電力用）
config ZMK_DISPLAY_TIMEOUT
    int
    default 5000  # 5秒でディスプレイOFF
  
if ZMK_DISPLAY

config I2C
    bool
    default y

config SSD1306
    bool
    default y

config SSD1306_REVERSE_MODE
    bool
    default y

endif # ZMK_DISPLAY



endif # CHOCOLATEBOX
```

## config/boards/shields/chocolatebox/dts/bindings/gpio/microchip,mcp23017.yaml
```yaml
description: MCP23017 GPIO controller

compatible: "microchip,mcp23017"

include: [gpio-controller.yaml, i2c-device.yaml]

properties:
  "#gpio-cells":
    const: 2

  ngpios:
    type: int
    required: true
    description: Number of GPIOs available

gpio-cells:
  - pin
  - flags
```

## config/boards/shields/mochiko32/Kconfig.defconfig
```kconfig
if MOCHIKO32

config ZMK_KEYBOARD_NAME
    default "mochiko32"

config SPI
    default y


endif
```

## config/west.yml
```yaml
manifest:
  remotes:
    ...
    # START #####
    - name: badjeff
      url-base: https://github.com/badjeff
    # END #######
    ...
  projects:
    ...
    # START #####
    - name: zmk-pmw3610-driver
      remote: badjeff
      revision: main
    # END #######
    ...
  self:
    path: config
```

## modules/twist-scroll/dts/bindings/behaviors/zmk,behavior-twist-toggle.yaml
```yaml
# SPDX-License-Identifier: MIT
title: Twist Scroll Toggle Behavior
type: behavior
compatible: "zmk,behavior-twist-toggle"
description: Toggle SlimBlade-like twist-to-scroll mode

properties:
  label:
    type: string
    required: false
```
